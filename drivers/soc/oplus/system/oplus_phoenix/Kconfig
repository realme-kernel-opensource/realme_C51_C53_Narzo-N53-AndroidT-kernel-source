## drivers/soc/oplus/system/oplus_phoenix/Kconfig
```kconfig
#change 'y' to 'n', if you want fo close phoenix feature
config OPLUS_FEATURE_PHOENIX
    tristate "oppo phoenix project"
    default y
    help
      define this config to init oppo phoenix project.
```
